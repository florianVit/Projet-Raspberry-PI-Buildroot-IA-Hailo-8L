## Package-Buildroot/hailort/Config.in
```kconfig
config BR2_PACKAGE_HAILORT
    bool "Hailort"
    
    select BR2_PACKAGE_SPDLOG
    select BR2_PACKAGE_PROTOBUF
    select BR2_PACKAGE_EIGEN
```

## Package-Buildroot/pandas/Config.in
```kconfig
config BR2_PACKAGE_PANDAS
    bool "Pandas"
    depends on BR2_PACKAGE_PYTHON3
    select BR2_PACKAGE_NUMPY
    help
      Pandas est une bibliothèque pour manipuler et analyser des structures de données.

      Dépendances :
        - numpy
        - python-dateutil (gestion des dates)
        - pytz (gestion des fuseaux horaires)

      Site officiel : https://pandas.pydata.org
```

## Package-Buildroot/seaborn/Config.in
```kconfig
config BR2_PACKAGE_SEABORN
    bool "Seaborn"
    depends on BR2_PACKAGE_PANDAS
    select BR2_PACKAGE_MATPLOTLIB
    select BR2_PACKAGE_NUMPY
    select BR2_PACKAGE_SCIPY
    help
      Seaborn est une bibliothèque pour créer des visualisations de données.

      Dépendances :
        - pandas
        - matplotlib
        - numpy
        - scipy

      Site officiel : https://seaborn.pydata.org
```

## Package-Buildroot/tensorflow-projects/Config.in
```kconfig
config BR2_PACKAGE_TENSORFLOW_PROJECTS
    bool "tensor-project"
    select BR2_PACKAGE_OPENCV4
    help
      Demo minimal utilisant TFLite avec un modèle .tflite préchargé.
```

## Package-Buildroot/torch/Config.in
```kconfig
config BR2_PACKAGE_TORCH
    bool "PyTorch"
    depends on BR2_PACKAGE_PYTHON3
    select BR2_PACKAGE_NUMPY
    select BR2_PACKAGE_PYYAML
    select BR2_PACKAGE_REQUESTS
    select BR2_PACKAGE_TYPING_EXTENSIONS
    help
      PyTorch est un framework open-source pour l’apprentissage profond.

      Dépendances :
        - numpy
        - pyyaml
        - requests
        - typing_extensions

      Site officiel : https://pytorch.org
```

## Package-Buildroot/torchvision/Config.in
```kconfig
config BR2_PACKAGE_TORCHVISION
    bool "Torchvision"
    depends on BR2_PACKAGE_TORCH
    select BR2_PACKAGE_NUMPY
    select BR2_PACKAGE_PILLOW
    select BR2_PACKAGE_REQUESTS
    help
      Torchvision fournit des outils pour manipuler des images et charger des modèles pré-entraînés.

      Dépendances :
        - torch
        - pillow (traitement d’images)
        - requests (téléchargement de modèles)

      Site officiel : https://pytorch.org/vision/stable/index.html
```

## Package-Buildroot/ultralytics-thop/Config.in
```kconfig
config BR2_PACKAGE_ULTRALYTICS_THOP
    bool "Ultralytics-THOP"
    depends on BR2_PACKAGE_TORCH
    select BR2_PACKAGE_NUMPY
    help
      Ultralytics-THOP est une bibliothèque pour calculer les FLOPs des modèles.

      Dépendances :
        - torch
        - numpy

      Site officiel : https://github.com/ultralytics/thop
```

## Package-Buildroot/ultralytics/Config.in
```kconfig
config BR2_PACKAGE_ULTRALYTICS
    bool "Ultralytics"
    depends on BR2_PACKAGE_PYTHON3
    select BR2_PACKAGE_TORCH
    select BR2_PACKAGE_TORCHVISION
    select BR2_PACKAGE_PANDAS
    select BR2_PACKAGE_NUMPY
    select BR2_PACKAGE_PILLOW
    select BR2_PACKAGE_PYYAML
    select BR2_PACKAGE_REQUESTS
    select BR2_PACKAGE_SCIENTIFIC
    select BR2_PACKAGE_PSUTIL
    select BR2_PACKAGE_TQDM
    help
      Ultralytics est un framework basé sur PyTorch utilisé pour la détection d'objets, en particulier YOLO.

      Dépendances :
        - torch
        - torchvision
        - pandas
        - numpy
        - pillow
        - pyyaml
        - requests
        - scipy
        - psutil
        - tqdm

      Site officiel : https://github.com/ultralytics/ultralytics
```
